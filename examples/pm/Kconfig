## examples/pm/Kconfig
```kconfig
#
# For a description of the syntax of this configuration file,
# see the file kconfig-language.txt in the NuttX tools repository.
#

config EXAMPLES_PM
  tristate "Power Managment example"
  depends on PM && LIB_BOARDCTL
	default n
	---help---
		Enable the pm application

if EXAMPLES_PM

config PM_PRIORITY
	int "Task priority"
	default 100

config PM_STACKSIZE
	int "Stack size"
	default 2048

endif
```

## graphics/Kconfig
```kconfig
#
# For a description of the syntax of this configuration file,
# see the file kconfig-language.txt in the NuttX tools repository.
#

menu "Graphics Support"
source "$APPSDIR/graphics/ft80x/Kconfig"
source "$APPSDIR/graphics/lvgl/Kconfig"
source "$APPSDIR/graphics/nxglyphs/Kconfig"
source "$APPSDIR/graphics/nxwidgets/Kconfig"
source "$APPSDIR/graphics/nxwm/Kconfig"
source "$APPSDIR/graphics/pdcurs34/Kconfig"
source "$APPSDIR/graphics/screenshot/Kconfig"
source "$APPSDIR/graphics/slcd/Kconfig"
source "$APPSDIR/graphics/tiff/Kconfig"
source "$APPSDIR/graphics/twm4nx/Kconfig"
endmenu # Graphics Support
```

## testing/Kconfig
```kconfig
menu "Testing"
source "$APPSDIR/testing/sensortest/Kconfig"
source "$APPSDIR/testing/ostest/Kconfig"
source "$APPSDIR/testing/fstest/Kconfig"
source "$APPSDIR/testing/smart/Kconfig"
source "$APPSDIR/testing/scanftest/Kconfig"
source "$APPSDIR/testing/smart_test/Kconfig"
source "$APPSDIR/testing/fatutf8/Kconfig"
source "$APPSDIR/testing/smp/Kconfig"
source "$APPSDIR/testing/irtest/Kconfig"
source "$APPSDIR/testing/cxxtest/Kconfig"
source "$APPSDIR/testing/unity/Kconfig"
source "$APPSDIR/testing/nxffs/Kconfig"
source "$APPSDIR/testing/mm/Kconfig"
source "$APPSDIR/testing/ltp/Kconfig"
source "$APPSDIR/testing/getprime/Kconfig"
endmenu
```

## wireless/Kconfig
```kconfig
#
# For a description of the syntax of this configuration file,
# see the file kconfig-language.txt in the NuttX tools repository.
#

menu "Wireless Libraries and NSH Add-Ons"
endmenu # Wireless Libraries and NSH Add-Ons
```
